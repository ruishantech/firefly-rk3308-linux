// SPDX-License-Identifier: (GPL-2.0+ OR MIT)
/*
   Copyright (c) 2018 Fuzhou Rockchip Electronics Co., Ltd
 */

#include "arm/rk3308-dot-rk816-v10-aarch32.dts"

/ {
        model = "Rockchip RK3308 Dot with rk816 board (AArch64)";
        compatible = "rockchip,rk3308-dot-rk816-v10", "rockchip,rk3308";
};

&ramoops_mem {
	reg = <0x0 0x110000 0x0 0xf0000>;
};

&ramoops {
	record-size = <0x0 0x30000>;
	console-size = <0x0 0xc0000>;
};
