// SPDX-License-Identifier: (GPL-2.0+ OR MIT)
/*
 * Copyright (c) 2018 Fuzhou Rockchip Electronics Co., Ltd
 */

/dts-v1/;

#include "rk3308b-firefly.dtsi"
#include "rk3308b-roc-cc-plus.dtsi"
#include "rk3308b-roc-cc-plus-ext.dtsi"

/ {
	model = "Firefly ROC-RK3308B-CC-PLUS analog mic ext board";
	compatible = "firefly,rk3308b-roc-cc-plus-amic-ext_emmc", "firefly,rk3308", "rockchip,rk3308";

	chosen {
        bootargs = "earlycon=uart8250,mmio32,0xff0e0000 swiotlb=1 console=ttyFIQ0 root=PARTLABEL=buildroot rootfstype=ext4 rootwait snd_aloop.index=7 snd_aloop.use_raw_jiffies=1 overlayroot=device:dev=PARTLABEL=userdata,fstype=ext4,mkfs=1 coherent_pool=1m systemd.gpt_auto=0 cgroup_enable=memory swapaccount=1";
    };

};

