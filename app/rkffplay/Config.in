## buildroot/configs/firefly_rk3308_recovery_defconfig
```kconfig
#include "rk3308_arm.config"
#include "base.config"
#include "base_extra.config"
#include "recovery.config"
BR2_PACKAGE_UPDATE=y
BR2_PACKAGE_RKUPDATE=y
```

## buildroot/package/rockchip/adbd/Config.in
```kconfig
config BR2_PACKAGE_ADBD
	bool "adbd porting for Linux"
	depends on BR2_USE_MMU # uses fork()
    select BR2_PACKAGE_OPENSSL
    select BR2_PACKAGE_ZLIB
```

## buildroot/package/rockchip/firefly4g/Config.in
```kconfig
config BR2_PACKAGE_FIREFLY4G
        bool "setup data connection for 4G module EC20"
        depends on BR2_PACKAGE_DHCPCD # uses fork()

if BR2_PACKAGE_FIREFLY4G
	config BR2_PACKAGE_EC20HOTPLUG
		bool "usb hot plug for 4G module EC20"
endif
```

## buildroot/package/rockchip/firefly_bridge_net/Config.in
```kconfig
config BR2_PACKAGE_FIREFLY_BRIDGE_NET
    bool "firefly bridge net"
    select BR2_PACKAGE_BRIDGE_UTILS
    select BR2_PACKAGE_DHCP
    select BR2_PACKAGE_DHCP_SERVER
    select BR2_PACKAGE_DHCP_CLIENT
	help
        Based on rk3308, bridge eth0, eth1 to virtual network interface br0.
```

## buildroot/package/rockchip/firefly_choose_rootfs/Config.in
```kconfig
config BR2_PACKAGE_FIREFLY_CHOOSE_ROOTFS
    bool "choose_rootfs"
	help
      This is a tool for switching between multiple rootfs. 
      Currently only supports buildroot and ubutntu switching.
      Note that it is dangerous if your sdk doesn't support multiple rootfs.
```

## buildroot/package/rockchip/firefly_ec200s/Config.in
```kconfig
config BR2_PACKAGE_FIREFLY_EC200S
    bool "firefly ec200s"
	help
        Based on rk3308.
        Automatic dialing, and set the network data stream to usb0.
```

## buildroot/package/rockchip/firefly_test/Config.in
```kconfig
config BR2_PACKAGE_FIREFLY_TEST
    select BR2_PACKAGE_OPENSSL
    select BR2_PACKAGE_COREUTILS
    bool "Firefly test tool"
```

## buildroot/package/rockchip/firefly_wifi_tool/Config.in
```kconfig
config BR2_PACKAGE_FIREFLY_WIFI_TOOL
    bool "firefly wifi tool"
    select BR2_PACKAGE_DHCP
    select BR2_PACKAGE_DHCP_SERVER
    select BR2_PACKAGE_DHCP_CLIENT
```

## buildroot/package/rockchip/iot_client/Config.in
```kconfig
config BR2_PACKAGE_IOT_CLIENT
bool "iot_client app"
    select BR2_PACKAGE_LIBMODBUS
    select BR2_PACKAGE_PAHO_MQTT_C
    select BR2_PACKAGE_ZLOG
```

## buildroot/package/rockchip/minigui_desktop/Config.in
```kconfig
config BR2_PACKAGE_MINIGUI_DESKTOP
	bool "Minigui demo desktop"
	depends on BR2_PACKAGE_MINIGUI
	select BR2_PACKAGE_RTC_DEMO
	select BR2_PACKAGE_TSLIB
	select BR2_PACKAGE_LIBPNG12
	select BR2_PACKAGE_JPEG
	select BR2_PACKAGE_FREETYPE
	help
	  Minigui demo desktop


if BR2_PACKAGE_MINIGUI_DESKTOP

choice
    prompt "Touch Screen Size"
    default BR2_PACKAGE_MINIGUI_DESKTOP_4_INCH
    help
      Select 4-inch touch screen
      or 7-inch touch screen

    config BR2_PACKAGE_MINIGUI_DESKTOP_4_INCH
    bool "4 inch"
    help
        Set compatible with 4-inch touch screen

    config BR2_PACKAGE_MINIGUI_DESKTOP_7_INCH
    bool "7 inch"
    help
        Set compatible with 7-inch touch screen
endchoice

endif


config BR2_PACKAGE_MINIGUI_RKKEYBOARD_EVENT
	string "RK KEY BOARD EVENT"
	default "event0"
	depends on BR2_PACKAGE_MINIGUI_DESKTOP
	help
		RK KEY BOARD EVENT
```

## buildroot/package/rockchip/modbus-utils/Config.in
```kconfig
config BR2_PACKAGE_MODBUS_UTILS
bool "modbus utils: include client and server"
    select BR2_PACKAGE_LIBMODBUS
```

## kernel/Documentation/devicetree/bindings/media/gpio-ir-receiver.txt
```
Device-Tree bindings for GPIO IR receiver

Required properties:
	- compatible: should be "gpio-ir-receiver".
	- gpios: specifies GPIO used for IR signal reception.

Optional properties:
	- pinctrl-names, pinctrl-0: the pincontrol settings to configure io mux.

Example node:

	ir_rx {
		compatible = "gpio-ir-receiver";
                gpios = <&gpio0 RK_PC0 GPIO_ACTIVE_HIGH>;
                pinctrl-names = "default";
                pinctrl-0 = <&ir_recv_pin>;
	};
```

## kernel/Documentation/devicetree/bindings/media/pwm-ir-tx.txt
```
Device-Tree bindings for PWM IR transmit

Required properties:
	- compatible: should be "pwm-ir-tx".
	- pwms: specifies PWM used for sent IR signal.


Example node:

	ir_tx {
                compatible = "pwm-ir-tx";
                pwms = <&pwm1 0 25000 0>;
	};
```

## kernel/drivers/misc/nations_tech/Kconfig
```kconfig
menuconfig NATIONS_TECH
	tristate "Nations Technologies"
	default y
	help
	  This enables support for Nations Technologies.
	  Nations Technologies Inc. (“Nations”) is a leader in China’s information security IC design industry and a national high-tech enterprise.

if NATIONS_TECH

comment "Nations Devices"

config NATIONS_N32S032
        bool "Nations N32S032"
        default n
        help
          If you say yes here, nations n32s032 will be set using

endif
```
